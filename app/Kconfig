## app/Kconfig
```kconfig
menuconfig LED_SUBSYSTEM
    bool "LED subsystem"
    default y

    if LED_SUBSYSTEM
        config APP_HEARTBEAT_PERIOD_MS
        int "Heart beat period in ms (100 - 2000)"
        default    500
        range      100 2000
    endif
    
    source "kconfig.zephyr"
    rsource "drivers/our_driver/kconfig"
```

## app/boards/my_board/board.yml
```yaml
board:
  name: my_board
  full_name: My Board from scratch
  vendor: Iomico 
  socs:
    - name: stm32f407xx
```

## app/boards/our_board/board.yml
```yaml
board:
  name: our_board
  full_name: Our Board
  vendor: Iomico 
  socs:
    - name: stm32f407xx
```
